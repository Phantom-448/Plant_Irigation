## main/Kconfig.projbuild
```kconfig
menu "WIFI Configuration"
    config ESP_WIFI_SSID
        string "Viktor"
        default "dein_wlan_name"
    config ESP_WIFI_PASSWORD
        string "minecraft"
        default "dein_passwort"
endmenu
```
